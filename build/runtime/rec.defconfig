## build/runtime/rec.defconfig
```kconfig
# ARM64 tools only: the project supplies the kernel, init, UI and adbd.
BR2_aarch64=y
BR2_TOOLCHAIN_BUILDROOT_MUSL=y
BR2_KERNEL_HEADERS_6_12=y
BR2_TOOLCHAIN_BUILDROOT_CXX=y
BR2_SHARED_STATIC_LIBS=y
BR2_REPRODUCIBLE=y
BR2_GLOBAL_PATCH_DIR="$(LIUQIN_RUNTIME_CONFIG)/patches"
BR2_TARGET_OPTIMIZATION="-Os"
BR2_INIT_NONE=y
BR2_ROOTFS_DEVICE_CREATION_STATIC=y
# BR2_TARGET_GENERIC_GETTY is not set
# BR2_TARGET_GENERIC_REMOUNT_ROOTFS_RW is not set
# BR2_TARGET_ROOTFS_TAR is not set
BR2_PACKAGE_BUSYBOX=y
BR2_PACKAGE_BUSYBOX_SHOW_OTHERS=y
BR2_PACKAGE_BUSYBOX_CONFIG_FRAGMENT_FILES="$(LIUQIN_RUNTIME_CONFIG)/busybox.config"
BR2_PACKAGE_PYTHON3=y
BR2_PACKAGE_PYTHON3_PY_ONLY=y
BR2_PACKAGE_PYTHON3_BZIP2=y
BR2_PACKAGE_PYTHON3_DECIMAL=y
BR2_PACKAGE_PYTHON3_SSL=y
BR2_PACKAGE_PYTHON3_PYEXPAT=y
BR2_PACKAGE_PYTHON3_XZ=y
BR2_PACKAGE_PYTHON3_ZLIB=y
BR2_PACKAGE_PYTHON3_ZSTD=y
BR2_PACKAGE_TAR=y
BR2_PACKAGE_ACL=y
BR2_PACKAGE_ATTR=y
BR2_PACKAGE_LIBCAP=y
BR2_PACKAGE_LIBCAP_TOOLS=y
BR2_PACKAGE_GPTFDISK=y
BR2_PACKAGE_GPTFDISK_SGDISK=y
BR2_PACKAGE_E2FSPROGS=y
BR2_PACKAGE_BTRFS_PROGS=y
BR2_PACKAGE_F2FS_TOOLS=y
```
